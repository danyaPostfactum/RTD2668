#include "autoconf.h"

#ifdef CONFIG_ENABLE_HDMI

#define HDMI_COMPILE
#include <hdmi/hdmiFun.h>

HDMI_CONST HDMI_TIMING_COMPENSATION_T hdmi_timing_compensate[]= {  { 0, 0, 0, 0, 0, 0, 0 } // is zero terminate
};
HDMI_CONST HDCP_KEY_T default_hdcpkey =
{

    { 0xb7, 0x28, 0xa9, 0x51, 0xd6 },  // BKsv

    /*HDCP key table*/
    {
        0x3a, 0x21, 0x17, 0x06, 0x72, 0x60, 0x3b, 0x6e,     // Key0
        0x0c, 0x58, 0x16, 0x4c, 0x5b, 0x3b, 0x68, 0x4b,     // Key1
        0x2f, 0x7b, 0x5d, 0x64, 0x10, 0x60, 0x71, 0x41,     // Key2
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        0x76, 0x47, 0x13, 0x6f, 0x7e, 0x24, 0x5a, 0x6a,     // Key39
    }
};

HDMI_CONST HDMI_CHANNEL_T default_channel[HDMI_MAX_CHANNEL] =
{

    { 0x03, 0xE4 , 1,
        {
          //sms 2007-11-23
          #if 0//Realtek EDID
          0x00,0xFF,0xFF,0xFF,0xFF,0xFF,0xFF,0x00,0x20,0xA3,0x28,0x46,0x01,0x00,0x00,0x00,
          0x30,0x11,0x01,0x03,0x80,0x66,0x39,0x78,0x0A,0x0D,0xC9,0xA0,0x57,0x47,0x98,0x27,
          0x12,0x48,0x4C,0xBF,0xCF,0x00,0x01,0x01,0x01,0x01,0x01,0x01,0x01,0x01,0x01,0x01,
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          0x08,0x60,0x22,0x00,0x12,0x8E,0x21,0x08,0x08,0x18,0x00,0x00,0x00,0x00,0x00,0x29,
          #else
          0x00,0xFF,0xFF, 0xFF,0xFF,0xFF,0xFF,0x00,0x4A,0x8B,0x20,0x61,0x01,0x01,0x01,0x01,   
          0x01,0x0E,0x01,0x03,0x80,0x45,0x27,0x78,0x2A,0x7C,0x11,0x9E,0x59,0x47,0x9B,0x27,
          0x10,0x50,0x54,0x00,0x00,0x00,0x01,0x01,0x01,0x01,0x01,0x01,0x01,0x01,0x01,0x01,    
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          0x86,0x21,0x00,0x00,0x98,0x00,0x00,0x00,0x00,0x00,0x00,0x00,0x00,0x00,0x00,0x06,
          #endif
        },
        GPIO_HDMI0_HOT_PLUG,
        0,
        1,
        1
    },
#if 0
    { 0x07, 0x1b , 1,
        {
            //sms 2007-11-23
            0x00,0xFF,0xFF,0xFF,0xFF,0xFF,0xFF,0x00,0x20,0xA3,0x28,0x46,0x01,0x00,0x00,0x00,
            0x30,0x11,0x01,0x03,0x80,0x66,0x39,0x78,0x0A,0x0D,0xC9,0xA0,0x57,0x47,0x98,0x27,
            0x12,0x48,0x4C,0xBF,0xCF,0x00,0x01,0x01,0x01,0x01,0x01,0x01,0x01,0x01,0x01,0x01,
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            0x08,0x60,0x22,0x00,0x12,0x8E,0x21,0x08,0x08,0x18,0x00,0x00,0x00,0x00,0x00,0x29,
        },
        GPIO_HDMI1_HOT_PLUG ,
        1,
        1,
        1

    },
#endif
};

/**
 * hdmi_inl
 * Columbus hdmi register read
 *
 * @param <addr>	{ addr of register }
 * @return 		{ read value }
 * @ingroup drv_hdmi
 */

UINT8 hdmiport_in(UINT8 addr)
{
    UINT8 result;
    rtdf_pageSelect(0x02);	// according to spec
    hdmi_out(HDMI_HDMI_AP_VADDR, addr);
    result = (UINT8) (hdmi_in(HDMI_HDMI_DP_VADDR) & 0xFF);
    return result;
}

/**
 * hdmi_outl
 * Columbus hdmi register write
 *
 * @param <addr>	{ addr of register }
 * @param <value>	{ write value }
 * @return
 * @ingroup drv_hdmi
 */

void hdmiport_out(UINT8 addr, UINT8 value)
{

    rtdf_pageSelect(0x02);	// according to spec
    hdmi_out(HDMI_HDMI_AP_VADDR, addr);
    hdmi_out(HDMI_HDMI_DP_VADDR, value);
}

/**
 * hdmi_maskl
 * Columbus register read and mask function
 *
 * @param <addr>	{ register addr }
 * @param <andmask> { andmask AND with register value }
 * @param <ormask>  { ormask OR with register value }
 * @return
 * @ingroup drv_hdmi
 */
void hdmiport_mask(UINT8 addr, UINT8 andmask, UINT8 ormask)
{
    UINT8 result;
    rtdf_pageSelect(0x02);	// according to spec
    hdmi_out(HDMI_HDMI_AP_VADDR, addr);
    result = (UINT8) (hdmi_in(HDMI_HDMI_DP_VADDR) & 0xFF);
    result &= andmask;
    result |= ormask;
    hdmi_out(HDMI_HDMI_AP_VADDR, addr);
    hdmi_out(HDMI_HDMI_DP_VADDR, result);

}


void HdmiISREnable(char nEnable)
{
    if (nEnable)
        rtd_hdmiRx_cmd(IOCTRL_HDMI_PHY_START, 0);
    else
        rtd_hdmiRx_cmd(IOCTRL_HDMI_PHY_STOP, 0);

}
void HdmiISRInit(void)
{

#if 0
    rtd_maskl(BUS_SIC_M_GIR5_ADDR, ~(0x0f << 28), 12 << 28);
    rtd_maskl(BUS_SIC_M_GIE1_ADDR, ~(0x01 << 23), 0 << 23);

    rtd_outl(TC_TMR7_DBR_ADDR, (0xa9 << 16));    // clock source : 27000000/16/0xA9 = 9.985Khz ~ 10Khz
    rtd_outl(TC_TMR7_DR_ADDR, (100 << 8));       // 10ms
    rtd_outl(TC_TMR7_VR_ADDR, 1);   			    // clear interrupt pending
    rtd_outl(TC_TMR7_CR_ADDR, _BIT31 | _BIT30 | _BIT29);

    result = request_irq(12, rtd_hdmiRx_ISR,  0, "hdmiRx", 0);
#endif
    HdmiISREnable(0);
}

#if 0	// temporarily used
void HdmiISRClose(void)
{

    HdmiISREnable(0);
}
#endif

void HdmiGetStruct(HDMIRX_IOCTL_STRUCT_T* ptr)
{
    rtd_hdmiRx_cmd(IOCTRL_HDMI_GET_STRUCT, ptr);
}


void HdmiSetScalerColor(void)
{
    drv_color_set422to444(GET_SCALER_IS422());
    drv_color_colorspacergb2yuvtransfer(GET_INPUTSOURCE_TYPE(), (GET_SCALER_IVHEIGHT() > 720 ? 1 : 0), (info->ucMode_Curr !=_HDMIMODE_NEW ? 1:0));
}

HDMI_BOOL Hdmi_Search_Mode(void)
{

    UINT8 i;

    for (i=_HDMI_MODE_480I; i<=_HDMI_MODE_1080P30; i++)  		// search HDMI table first
    {
        if (GET_ISHDMI() == MODE_DVI)
            break;
        if (mode_identifymode(i))
        {
            SET_MODE_CURR(i);
            SET_SCALER_MODE_CURR(i);
            mode_setHDMIinfo(i);
            //HDMI_LOG(LOGGER_INFO,"1.find table mode:%d\n",(UINT32)i);
            return TRUE;
        }
    }

    for (i=_MODE_640x350_70HZ; i<=_MODE_1600x1200_60HZ; i++)  	// search DVI table
    {
        if (mode_identifymode(i))
        {
            SET_MODE_CURR(i);
            SET_SCALER_MODE_CURR(i);
            //HDMI_LOG(LOGGER_INFO,"2.find table mode:%d\n",(UINT32)i);
            return TRUE;
        }
    }

    /*for (i = _HDMI_MODE_1080PM50; i<= _HDMI_MODE_1080PM60; i++) {
    	if (mode_identifymode(i)) {
    		SET_MODE_CURR(i);
    		SET_SCALER_MODE_CURR(i);
    		//HDMI_LOG(LOGGER_INFO,"3.find table mode:%d\n",(UINT32)i);
    		return TRUE;
    	}
    }*/

    i = _MODE_NEW;

    SET_MODE_CURR(i);
    SET_SCALER_MODE_CURR(i);
    HDMI_LOG(LOGGER_INFO,"cannot find!\n");
    return FALSE;

}
#endif
